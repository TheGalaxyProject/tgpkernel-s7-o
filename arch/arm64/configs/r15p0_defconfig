## arch/arm64/configs/r15p0_defconfig
```kconfig
#
# Modifications for r15p0 GPU Drivers
#
CONFIG_MALI_R15P0=y
# CONFIG_MALI_R22P0 is not set
CONFIG_MALI_PLATFORM_THIRDPARTY=y
CONFIG_MALI_PLATFORM_THIRDPARTY_NAME="exynos"
# CONFIG_MALI_PLATFORM_NAME is not set
```
